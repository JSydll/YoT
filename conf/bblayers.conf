## conf/bblayers.conf
```bitbake
# -------------------
# Yocto layer configuration 
#
# For all machines, contains the basic functionality
# -------------------
POKY_BBLAYERS_CONF_VERSION = "2"

BBPATH = "${TOPDIR}"
BBFILES ?= ""

# Community layers - be aware that order matters here.
BBLAYERS ?= " \
  ${PROJECT_ROOT}/poky/meta \
  ${PROJECT_ROOT}/poky/meta-poky \
  ${PROJECT_ROOT}/poky/meta-openembedded/meta-oe \
  ${PROJECT_ROOT}/poky/meta-openembedded/meta-multimedia \
  ${PROJECT_ROOT}/poky/meta-openembedded/meta-networking \
  ${PROJECT_ROOT}/poky/meta-openembedded/meta-python \
  ${PROJECT_ROOT}/poky/meta-openembedded/meta-perl \
	${PROJECT_ROOT}/poky/meta-swupdate \
  ${PROJECT_ROOT}/poky/meta-security \
  "

# Default features
BBLAYERS += " \
  ${PROJECT_ROOT}/src/meta-common \
  ${PROJECT_ROOT}/src/meta-userenv \
  ${PROJECT_ROOT}/src/meta-hardening \
  ${PROJECT_ROOT}/src/meta-fota \
  "
```

## conf/local.conf
```bitbake
# ----------------
# General defaults
# ----------------
# From the generated localconf
DISTRO ?= "poky"
PACKAGE_CLASSES ?= "package_rpm"
USER_CLASSES ?= "buildstats image-mklibs image-prelink"
PATCHRESOLVE = "noop"
BB_DISKMON_DIRS ??= "\
    STOPTASKS,${TMPDIR},1G,100K \
    STOPTASKS,${DL_DIR},1G,100K \
    STOPTASKS,${SSTATE_DIR},1G,100K \
    STOPTASKS,/tmp,100M,100K \
    ABORT,${TMPDIR},100M,1K \
    ABORT,${DL_DIR},100M,1K \
    ABORT,${SSTATE_DIR},100M,1K \
    ABORT,/tmp,10M,1K"
PACKAGECONFIG_append_pn-qemu-system-native = " sdl"
CONF_VERSION = "1"

# -------------------
# Build configuration 
#
# For all machines
# -------------------
RM_OLD_IMAGE = "1"
INHERIT += "rm_work"

# ---------------------
# Basic features enabled globally
# ---------------------
# Using systemd instead of sysvinit
DISTRO_FEATURES_append += " systemd"
VIRTUAL-RUNTIME_init_manager = "systemd"
DISTRO_FEATURES_BACKFILL_CONSIDERED = "sysvinit"
VIRTUAL-RUNTIME_initscripts = ""

# ---------------------
# Image generation
# ---------------------
IMAGE_FSTYPES = "ext4 ext4.gz"
#IMAGE_FSTYPES += " squashfs "
#EXTRA_IMAGE_FEATURES += "read-only-rootfs"

# ---------------------
# Disabled distro features
# ---------------------
#DISTRO_FEATURES_remove = "3g"
#DISTRO_FEATURES_remove = "opengl"
#DISTRO_FEATURES_remove = "wayland"
#DISTRO_FEATURES_remove = "x11"
#DISTRO_FEATURES_remove = "nfc"
#DISTRO_FEATURES_remove = "nfs"
#DISTRO_FEATURES_remove = "ext2"
```

## src/meta-application/conf/layer.conf
```bitbake
# -------------------
# meta-application layer configuration
# -------------------

# -------------------
# Configuration variable defaults
# -------------------
APP_CMAKE_AUTOLOAD ?= "1"
APP_CMAKE_INSTALL_PATH ?= "/usr/bin"
APP_CMAKE_EXEC_USER ?= "root"
# Not set by default:
# APP_CMAKE_URL ?= 
# APP_CMAKE_TAG ?= 

BBPATH .= ":${LAYERDIR}"

# -------------------
# Included recipes
# -------------------
BBFILES += "${LAYERDIR}/recipes-*/*/*.bb \
            ${LAYERDIR}/recipes-*/*/*.bbappend"

# -------------------
# General layer settings
# -------------------
BBFILE_COLLECTIONS += "meta-application"
BBFILE_PATTERN_meta-application = "^${LAYERDIR}/"
BBFILE_PRIORITY_meta-application = "6"

LAYERDEPENDS_meta-application = "core meta-common"
LAYERSERIES_COMPAT_meta-application = "warrior zeus"


# -------------------
# Image extensions
# -------------------
IMAGE_INSTALL_append = " \
    ${@ 'cmakeapp' if d.getVar('APP_CMAKE_URL') != None else ''} \
"
```

## src/meta-cmakeapp/conf/layer.conf
```bitbake
# -------------------
# meta-cmakeapp layer configuration
# -------------------

# -------------------
# Configuration variable defaults
# -------------------
APP_CMAKE_AUTOLOAD ?= "1"
APP_CMAKE_INSTALL_PATH ?= "/usr/bin"
APP_CMAKE_EXEC_USER ?= "root"
# Not set by default:
# APP_CMAKE_URL ?= 
# APP_CMAKE_TAG ?= 

BBPATH .= ":${LAYERDIR}"

# -------------------
# Included recipes
# -------------------
BBFILES += "${LAYERDIR}/recipes-*/*/*.bb \
            ${LAYERDIR}/recipes-*/*/*.bbappend"

# -------------------
# General layer settings
# -------------------
BBFILE_COLLECTIONS += "meta-cmakeapp"
BBFILE_PATTERN_meta-cmakeapp = "^${LAYERDIR}/"
BBFILE_PRIORITY_meta-cmakeapp = "6"

LAYERDEPENDS_meta-cmakeapp = "core meta-common"
LAYERSERIES_COMPAT_meta-cmakeapp = "warrior zeus"


# -------------------
# Image extensions
# -------------------
IMAGE_INSTALL_append = " cmakeapp "
```

## src/meta-common/conf/layer.conf
```bitbake
# -------------------
# meta-common layer configuration
# -------------------

BBPATH .= ":${LAYERDIR}"

# -------------------
# General layer settings
# ------------------

BBFILE_COLLECTIONS += "meta-common"
BBFILE_PATTERN_meta-common = "^${LAYERDIR}/"
BBFILE_PRIORITY_meta-common = "6"

LAYERDEPENDS_meta-common = "core"
LAYERSERIES_COMPAT_meta-common = "warrior zeus"
```

## src/meta-common/wic/secure-base-mmc.wks
```
# short-description: Creates a secured, partitioned base MMC image
# long-description: Image with one read-only rootfs partition and one writable 
# overlay.

part /boot --source bootimg-partition --ondisk mmcblk0 --fstype=vfat --label boot --active --align 4096 --size 20
part / --source rootfs --ondisk mmcblk0 --fstype=ext4 --label root --align 4096
part --ondisk mmcblk0 --fstype=ext4 --label system --align 4096 --size 1G 
```

## src/meta-common/wic/secure-dual-copy-mmc.wks
```
# short-description: Creates a partitioned image for secure dual copy updates
# long-description: Image with two read-only rootfs partitions, one writable 
# overlay and one writable data partition.

part /boot --source bootimg-partition --ondisk mmcblk0 --fstype=vfat --label boot --active --align 4096 --size 20
part / --source rootfs --ondisk mmcblk0 --fstype=ext4 --label root --align 4096
part --source rootfs --ondisk mmcblk0 --fstype=ext4 --label root2 --align 4096
part --ondisk mmcblk0 --fstype=ext4 --label system --align 4096 --size 1G 
part /data --ondisk mmcblk0 --fstype=ext4 --label data --align 4096 --size 2G --fsoptions sync
```

## src/meta-connectivity/conf/layer.conf
```bitbake
# -------------------
# meta-connectivity layer configuration
# -------------------

# -------------------
# Configuration variable defaults
# -------------------
WIFI_ENABLED ?= "1"
WIFI_MODE ?= "client"
WIFI_SSID ?= "myhomelan"
WIFI_PWD ?= "secretsentence"
BT_ENABLED ?= "1"
SSH_ENABLED ?= "0"
NET_DNS_SERVER ?= "8.8.8.8"
# Not set by default:
# NET_STATIC_IP ?= 

BBPATH .= ":${LAYERDIR}"

# -------------------
# Included recipes
# -------------------
BBFILES += "${LAYERDIR}/recipes-*/*/*.bb \
            ${LAYERDIR}/recipes-*/*/*.bbappend"

# -------------------
# General layer settings
# -------------------
BBFILE_COLLECTIONS += "meta-connectivity"
BBFILE_PATTERN_meta-connectivity = "^${LAYERDIR}/"
BBFILE_PRIORITY_meta-connectivity = "6"

LAYERDEPENDS_meta-connectivity = "core meta-common"
LAYERSERIES_COMPAT_meta-connectivity = "warrior zeus"

# -------------------
# Image and distro extensions
# -------------------
DISTRO_FEATURES_append = " \
    ${@ 'wifi' if d.getVar('WIFI_ENABLED') == '1' else ''} \
    ${@ 'bluez5 bluetooth' if d.getVar('BT_ENABLED') == '1' else ''} \
"

IMAGE_INSTALL_append = " \
    ${@ 'openssh' if d.getVar('SSH_ENABLED') == '1' else ''} \
    ${@ 'iw iptables wpa-supplicant' if d.getVar('WIFI_ENABLED') == '1' else ''} \
    ${@ 'bluez5' if d.getVar('BT_ENABLED') == '1' else ''} \
"
```

## src/meta-fota/conf/layer.conf
```bitbake
# We have a conf and classes directory, add to BBPATH
BBPATH .= ":${LAYERDIR}"

# We have recipes-* directories, add to BBFILES
BBFILES += "${LAYERDIR}/recipes-*/*/*.bb \
            ${LAYERDIR}/recipes-*/*/*.bbappend"

BBFILE_COLLECTIONS += "meta-fota"
BBFILE_PATTERN_meta-fota = "^${LAYERDIR}/"
BBFILE_PRIORITY_meta-fota = "6"

LAYERDEPENDS_meta-fota = "core"
LAYERSERIES_COMPAT_meta-fota = "warrior zeus"
```

## src/meta-foundation/conf/layer.conf
```bitbake
# -------------------
# meta-foundation layer configuration
# -------------------

# -------------------
# Configuration variable defaults
# -------------------
SETTINGS_HOSTNAME ?= "${MACHINE}"
SETTINGS_CONSOLE_LANG ?= "en"
USERS_ROOT_PWD ?= "yasbi"
WIFI_ENABLED ?= "1"
WIFI_MODE ?= "client"
WIFI_SSID ?= "myhomelan"
WIFI_PWD ?= "secretsentence"
BT_ENABLED ?= "1"
# Not set by default:
# GROUPS_ADD_NAMES ?=
# USERS_ADD_NAMES ?=
# USERS_ADD_PWDS ?=
# USERS_ADD_GROUPS ?= 
# NET_STATIC_IP ?= 
# NET_DNS_SERVER ?= 

BBPATH .= ":${LAYERDIR}"

# -------------------
# Included recipes
# -------------------
BBFILES += "${LAYERDIR}/recipes-*/*/*.bb \
            ${LAYERDIR}/recipes-*/*/*.bbappend"

# -------------------
# General layer settings
# -------------------
BBFILE_COLLECTIONS += "meta-foundation"
BBFILE_PATTERN_meta-foundation = "^${LAYERDIR}/"
BBFILE_PRIORITY_meta-foundation = "6"

LAYERDEPENDS_meta-foundation = "core"
LAYERSERIES_COMPAT_meta-foundation = "warrior zeus"
```

## src/meta-fw-update-raspberrypi/conf/layer.conf
```bitbake
# We have a conf and classes directory, add to BBPATH
BBPATH .= ":${LAYERDIR}"

# We have recipes-* directories, add to BBFILES
BBFILES += "${LAYERDIR}/recipes-*/*/*.bb \
            ${LAYERDIR}/recipes-*/*/*.bbappend"

BBFILE_COLLECTIONS += "meta-fw-update-raspberrypi"
BBFILE_PATTERN_meta-fw-update-raspberrypi = "^${LAYERDIR}/"
BBFILE_PRIORITY_meta-fw-update-raspberrypi = "6"

LAYERDEPENDS_meta-fw-update-raspberrypi = "core meta-fw-update"
LAYERSERIES_COMPAT_meta-fw-update-raspberrypi = "warrior zeus"
```

## src/meta-fw-update-raspberrypi/wic/secure-update-raspi.wks
```
# short-description: Create a Raspberry Pi SD card image supporting secure updates
# long-description: Creates a partitioned SD card image for use with
# Raspberry Pi. Boot files are located in the first vfat partition

part /boot --source bootimg-partition --ondisk mmcblk0 --fstype=vfat --label boot --active --align 4096 --size 20
part / --source rootfs --ondisk mmcblk0 --fstype=ext4 --label root1 --align 4096
part --source rootfs --ondisk mmcblk0 --fstype=ext4 --label root2 --align 4096
part --source rootfs --ondisk mmcblk0 --fstype=ext4 --label system --align 4096
part --size 2G --ondisk mmcblk0 --fstype=ext4 --label data --align 4096
```

## src/meta-fw-update/conf/layer.conf
```bitbake
# -------------------
# meta-fw-update layer configuration
# -------------------

# -------------------
# Configuration variable defaults
# -------------------
UPDATE_IMAGE_VERSION ?= "0.1.0"
UPDATE_IMAGE_HWCOMPAT ?= "1.0"
UPDATE_IMAGE_FILENAME ?= "${UPDATE_IMAGE_BASE}-${MACHINE}"
UPDATE_MEM_DEVICE ?= "/dev/mmcblk0"

# We have a conf and classes directory, add to BBPATH
BBPATH .= ":${LAYERDIR}"

# We have recipes-* directories, add to BBFILES
BBFILES += "${LAYERDIR}/recipes-*/*/*.bb \
            ${LAYERDIR}/recipes-*/*/*.bbappend"

BBFILE_COLLECTIONS += "meta-fw-update"
BBFILE_PATTERN_meta-fw-update = "^${LAYERDIR}/"
BBFILE_PRIORITY_meta-fw-update = "6"

LAYERDEPENDS_meta-fw-update = "core meta-common swupdate"
LAYERSERIES_COMPAT_meta-fw-update = "warrior zeus"
```

## src/meta-hardening/conf/layer.conf
```bitbake
# We have a conf and classes directory, add to BBPATH
BBPATH .= ":${LAYERDIR}"

# We have recipes-* directories, add to BBFILES
BBFILES += "${LAYERDIR}/recipes-*/*/*.bb \
            ${LAYERDIR}/recipes-*/*/*.bbappend"

BBFILE_COLLECTIONS += "meta-hardening"
BBFILE_PATTERN_meta-hardening = "^${LAYERDIR}/"
BBFILE_PRIORITY_meta-hardening = "6"

LAYERDEPENDS_meta-hardening = "core"
LAYERSERIES_COMPAT_meta-hardening = "warrior zeus"
```

## src/meta-userenv/conf/layer.conf
```bitbake
# -------------------
# meta-userenv layer configuration
# -------------------

# -------------------
# Configuration variable defaults
# -------------------
ENV_HOSTNAME ?= "${MACHINE}"
ENV_CONSOLE_LANG ?= "en"
ENV_SUDO_ENABLED ?= "1"
ENV_SUDO_NOPASSWD ?= "0"
USERS_ROOT_PWD ?= "yasbi"
# Not set by default:
# GROUPS_ADD ?=
# USERS_ADD ?= 

BBPATH .= ":${LAYERDIR}"

# -------------------
# Included recipes
# -------------------
BBFILES += "${LAYERDIR}/recipes-*/*/*.bb \
            ${LAYERDIR}/recipes-*/*/*.bbappend"

# -------------------
# General layer settings
# -------------------
BBFILE_COLLECTIONS += "meta-userenv"
BBFILE_PATTERN_meta-userenv = "^${LAYERDIR}/"
BBFILE_PRIORITY_meta-userenv = "6"

LAYERDEPENDS_meta-userenv = "core meta-common"
LAYERSERIES_COMPAT_meta-userenv = "warrior zeus"

# -------------------
# Image extensions
# -------------------

# Keyboard layout
IMAGE_INSTALL_append = " loadkeys \
    ${@ 'sudo' if d.getVar('ENV_SUDO_ENABLED') == '1' else ''} \
"

# User and group setup
INHERIT += " usergroups extrausers "
EXTRA_USERS_PARAMS = "\
    usermod -P ${USERS_ROOT_PWD} root; \
    ${@usergroups_setup_groups(d)} \
    ${@usergroups_setup_users(d)} \
"
```
